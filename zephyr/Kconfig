## zephyr/Kconfig
```kconfig
config STM32_XCUBEUSBPD
    bool "Enable USB PD libraries from STM"
    default n
    depends on CMSIS_RTOS_V1

config STM32_XCUBEUSBPD_PORTNUM
    int "Number of ports"
    default 1
    depends on STM32_XCUBEUSBPD

choice STM32_XCUBEUSBPD_PORT0_ROLE
    bool "STM32 XCUBEUSBPD Port ROLE"
    default STM32_XCUBEUSBPD_PORT0_ROLE_NONE
    depends on STM32_XCUBEUSBPD

config STM32_XCUBEUSBPD_PORT0_ROLE_SNK
    bool "SNK0"

config STM32_XCUBEUSBPD_PORT0_ROLE_SRC
    bool "SRC0"

config STM32_XCUBEUSBPD_PORT0_ROLE_DRP
    bool "DRP0"

config STM32_XCUBEUSBPD_PORT0_ROLE_NONE
    bool "NONE"
endchoice

choice STM32_XCUBEUSBPD_PORT1_ROLE
    bool "STM32 XCUBEUSBPD Port ROLE"
    default STM32_XCUBEUSBPD_PORT1_ROLE_NONE
    depends on STM32_XCUBEUSBPD

config STM32_XCUBEUSBPD_PORT1_ROLE_SNK
    bool "SNK1"

config STM32_XCUBEUSBPD_PORT1_ROLE_SRC
    bool "SRC1"

config STM32_XCUBEUSBPD_PORT1_ROLE_DRP
    bool "DRP1"

config STM32_XCUBEUSBPD_PORT1_ROLE_NONE
    bool "NONE"
endchoice

config STM32_XCUBEUSBPD_HAS_SNK_SUPPORT
    bool "Compile in sink support"
    default y if STM32_XCUBEUSBPD_PORT0_ROLE_SNK || STM32_XCUBEUSBPD_PORT1_ROLE_SNK

config STM32_XCUBEUSBPD_HAS_SRC_SUPPORT
    bool "Compile in source support"
    default y if STM32_XCUBEUSBPD_PORT0_ROLE_SRC || STM32_XCUBEUSBPD_PORT1_ROLE_SRC

config STM32_XCUBEUSBPD_HAS_DRP_SUPPORT
    bool "Compile in DRP support"
    default y if STM32_XCUBEUSBPD_PORT0_ROLE_DRP || STM32_XCUBEUSBPD_PORT1_ROLE_DRP

config STM32_XCUBEUSBPD_HAS_VDM_SUPPORT
    bool "Enable USB PD VDM support with STM32 XCube library"
    default n
    depends on STM32_XCUBEUSBPD

config USBPD_SNK_MAX_MV
    int "Max allowed mV for a SNK application"
    depends on STM32_XCUBEUSBPD
    default 5000

config USBPD_SNK_MAX_MW
    int "Max allowed mW for a SNK application"
    depends on STM32_XCUBEUSBPD
    default 15000
```
